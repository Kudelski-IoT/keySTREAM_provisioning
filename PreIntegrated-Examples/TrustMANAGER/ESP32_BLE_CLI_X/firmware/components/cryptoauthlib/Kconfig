## PreIntegrated-Examples/TrustMANAGER/ESP32_BLE_CLI_X/firmware/components/cryptoauthlib/Kconfig
```kconfig
menu "CryptoAuthLib (ATECC608)"

config CRYPTOAUTHLIB_I2C_PORT
    int "I2C port"
    range 0 1
    default 0
    help
        ESP32 I2C port to use for the CryptoAuth device.

config CRYPTOAUTHLIB_I2C_SDA_GPIO
    int "I2C SDA GPIO"
    range 0 48
    default 21
    help
        SDA GPIO used to connect to the ATECC608.

config CRYPTOAUTHLIB_I2C_SCL_GPIO
    int "I2C SCL GPIO"
    range 0 48
    default 22
    help
        SCL GPIO used to connect to the ATECC608.

config CRYPTOAUTHLIB_I2C_FREQ_HZ
    int "I2C frequency (Hz)"
    range 10000 1000000
    default 100000
    help
        I2C frequency for the ATECC608.

config CRYPTOAUTHLIB_I2C_ADDR7
    hex "I2C address (7-bit)"
    range 0x03 0x77
    default 0x60
    help
        7-bit I2C address of the CryptoAuth device.

        Most ATECC608 parts use the default 0x60 (8-bit 0xC0). Some modules
        ship with a different address; use the I2C bus scan log from
        'cryptoauthlib_i2c' to pick the correct value.

config CRYPTOAUTHLIB_I2C_ADDR8
    hex "I2C address (8-bit, optional)"
    range 0x00 0xFE
    default 0x00
    help
        Optional 8-bit I2C address (left-shifted form) as some tools/logs print.

        Example: a scan may report 8-bit 0x70, which corresponds to 7-bit 0x38.
        If this value is non-zero, the firmware will use (ADDR8 >> 1) as the
        effective 7-bit address.

        Keep this at 0x00 to use the 7-bit address setting above.

config CRYPTOAUTHLIB_I2C_ENABLE_BUS_SCAN
    bool "Enable I2C bus scan at boot"
    default n
    help
        When enabled, CryptoAuthLib will scan the I2C bus once during init and
        log discovered devices.

        Note: On ESP-IDF, probing non-existent addresses can produce many NACK
        error logs. Keep this disabled unless debugging wiring/address issues.

endmenu
```

## PreIntegrated-Examples/TrustMANAGER/ESP32_BLE_CLI_X/firmware/sdkconfig.defaults
```kconfig
# CryptoAuthLib / ATECC I2C address
# Your scan reported a device at 8-bit 0x70 (which corresponds to 7-bit 0x38).
# Set ADDR8 to match the scan output; firmware converts it to 7-bit internally.
CONFIG_CRYPTOAUTHLIB_I2C_ADDR8=0x70

# I2C reliability: slower clock helps on long wires / weak pullups.
CONFIG_CRYPTOAUTHLIB_I2C_FREQ_HZ=50000

# One-time bus scan at boot to confirm which 7-bit address ACKs.
# (Can be noisy; disable again once confirmed.)
CONFIG_CRYPTOAUTHLIB_I2C_ENABLE_BUS_SCAN=y

# Override some defaults so BT stack is enabled
# (mirrors ESP-IDF examples/bluetooth/nimble/bleprph)

#
# BT config
#
CONFIG_BT_ENABLED=y
CONFIG_BTDM_CTRL_MODE_BLE_ONLY=y
CONFIG_BTDM_CTRL_MODE_BR_EDR_ONLY=n
CONFIG_BTDM_CTRL_MODE_BTDM=n
CONFIG_BT_BLUEDROID_ENABLED=n
CONFIG_BT_NIMBLE_ENABLED=y

# KTA activation (ATECC608 + cryptoauthlib) currently runs from the NimBLE host
# task context, which needs more stack than the ESP-IDF default.
CONFIG_BT_NIMBLE_HOST_TASK_STACK_SIZE=12288

#
# KTA (keySTREAM Trusted Agent)
#
CONFIG_KTA_USE_ATECC608=y
CONFIG_KTA_REQUIRE_ATECC608=y

# Force device back into onboarding (so conReq=1 and EXCHANGE runs)
# DISABLED: Breaks refurbish flow (server expects PROVISIONED state)
# CONFIG_KTA_FORCE_REPROVISION_ON_BOOT is not set

# Debug: print crypto input/output buffers (AES/HMAC)
CONFIG_KTA_CRYPTO_IO_LOG=y
CONFIG_KTA_CRYPTO_IO_LOG_MAX_BYTES=256
```

## PreIntegrated-Examples/TrustMANAGER/ESP32_Mobile_APP_X/firmware/main/Kconfig.projbuild
```kconfig
menu "Keystream BLE"

    config KTA_FORCE_REPROVISION_ON_BOOT
        bool "Force KTA reprovision on boot"
        default n
        help
            Clears KTA lifecycle state (stored in the ATECC608) back to INIT at every boot.
            This forces ktaSetDeviceInformation() to return connectionRequest=1 so the
            mobile app performs ktaExchangeMessage() (Activation Request generation).

    config KTA_CRYPTO_IO_LOG
        bool "Log crypto input/output (AES/HMAC)"
        default n
        help
            Prints crypto input/output buffers from the SAL crypto layer to ESP-IDF logs.
            WARNING: This can leak sensitive material (plaintext/ciphertext/MACs).

    config KTA_CRYPTO_IO_LOG_MAX_BYTES
        int "Max bytes to dump per buffer"
        default 256
        range 0 4096
        depends on KTA_CRYPTO_IO_LOG
        help
            Limits hexdump size per buffer to keep logs manageable.
            Set to 0 to disable buffer dumps (sizes still logged).

endmenu
```
